#pragma once
#include <Arduino.h>

namespace test {
  static constexpr uint8_t W = 36;
  static constexpr uint8_t H = 24;

  // 1-bit packed: 24 rows × 5 bytes (36 pixels wide)
  // Bit convention: byte0 bit7 = x0, ... byte4 bit4 = x35
  static const uint8_t data[H][5] PROGMEM = {
    {0x00, 0x00, 0x00, 0x00, 0x00},
    {0x00, 0x00, 0x00, 0x00, 0x00},
    {0x00, 0x00, 0x00, 0x00, 0x00},
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    {0x00, 0x00, 0x00, 0x00, 0x00}
  };

  // Draw helper: uses lcd.setPixel(), so it works with your current driver mapping.
  // x,y = top-left destination. threshold/invert already baked into data.
  template<typename LCD>
  inline void draw(LCD &lcd, int x0 = 0, int y0 = 0, bool on = true) {
    for (uint8_t y = 0; y < H; y++) {
      for (uint8_t x = 0; x < W; x++) {
        uint8_t byteIndex = x >> 3;
        uint8_t bit = 7 - (x & 7);
        uint8_t v = pgm_read_byte(&data[y][byteIndex]);
        if (v & (1 << bit)) {
          lcd.setPixel((uint8_t)(x0 + x), (uint8_t)(y0 + y), on);
        }
      }
    }
  }
}
